## zephyr/tests/encoder/testcase.yaml
```yaml
common:
  tags:
    - audio
    - maestro
  harness: console
  harness_config:
    type: one_line
    regex:
      - "(.*)Result: OK(.*)"
  timeout: 1
  integration_platforms:
    - rd_rw612_bga
  platform_allow:
    - rd_rw612_bga
  arch_allow: arm
tests:
  maestro.test.encoder.opus:
    build_only: true
    extra_configs:
      - CONFIG_MAESTRO_EXAMPLE_ENCODER_SELECTED_OPUS=y
  # maestro.test.encoder.opus_ogg:
  #   extra_configs:
  #     - CONFIG_MAESTRO_EXAMPLE_ENCODER_SELECTED_OPUS_OGG=y
```

## zephyr/tests/memToMem/testcase.yaml
```yaml
common:
  tags:
    - audio
    - maestro
  integration_platforms:
    - rd_rw612_bga
  arch_allow: arm
tests:
  maestro.test.system.mem2mem:
    tags:
     - audio
     - maestro
    harness: console
    harness_config:
      type: one_line
      regex:
        - "(.*)Result: OK(.*)"
    timeout: 1
    min_flash: 52
    min_ram: 52
```

## zephyr/tests/osa/testcase.yaml
```yaml
tests:
  # section.subsection
  maestro.ztest.osa:
    build_only: false
    # platform_allow:
    #  - native_posix
    #  - native_sim
      # - mimxrt1170_evkb_cm7
      # - rd_rw612_bga
    # integration_platforms:
    #   - native_sim
    #   - rd_rw612_bga
    tags: maestro
```
