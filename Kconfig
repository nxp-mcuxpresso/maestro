## Kconfig
```kconfig
# Copyright 2024 NXP
# SPDX-License-Identifier: BSD-3-Clause

menuconfig MCUX_COMPONENT_middleware.audio_voice.maestro
    bool "Audio Maestro framework"
    default n
    help
        This option enables the audio Maestro framework

if MCUX_COMPONENT_middleware.audio_voice.maestro
    menu "Elements"
        config MAESTRO_ELEMENTS_ALL_ENABLE
            bool "Enables all supported elements"
            default n
            select MCUX_COMPONENT_middleware.audio_voice.maestro.element.audio_proc.enable
            select MCUX_COMPONENT_middleware.audio_voice.maestro.element.audio_sink.enable
            select MCUX_COMPONENT_middleware.audio_voice.maestro.element.audio_src.enable
            select MCUX_COMPONENT_middleware.audio_voice.maestro.element.file_sink.enable
            select MCUX_COMPONENT_middleware.audio_voice.maestro.element.file_src.enable
            select MCUX_COMPONENT_middleware.audio_voice.maestro.element.mem_sink.enable
            select MCUX_COMPONENT_middleware.audio_voice.maestro.element.mem_src.enable
            select MCUX_COMPONENT_middleware.audio_voice.maestro.element.netbuf_src.enable
            select MCUX_COMPONENT_middleware.audio_voice.maestro.element.process_sink.enable
            select MCUX_COMPONENT_middleware.audio_voice.maestro.element.decoder.enable
            select MCUX_COMPONENT_middleware.audio_voice.maestro.element.encoder.enable

        menuconfig MCUX_COMPONENT_middleware.audio_voice.maestro.element.audio_proc.enable
            bool "Audio process"
            default n
            if MCUX_COMPONENT_middleware.audio_voice.maestro.element.audio_proc.enable
                config MCUX_COMPONENT_middleware.audio_voice.maestro.element.audio_proc.ssrc.enable
                    bool "Enables Synchronous sample rate converter processing element"
                    select MCUX_COMPONENT_middleware.audio_voice.components.ssrc
                    default n
                    depends on MCUX_HW_CORE_CM7F || MCUX_HW_CORE_CM33 || MCUX_HW_CORE_CM33F
                config MCUX_COMPONENT_middleware.audio_voice.maestro.element.audio_proc.asrc.enable
                    bool "Enables Asynchronous sample rate converter processing element"
                    select MCUX_COMPONENT_middleware.audio_voice.components.asrc
                    default n
                    depends on MCUX_HW_CORE_CM7F
                config MAESTRO_ELEMENT_AUDIO_PROC_VIT_ENABLE
                    bool "Enables VIT processing element"
                    select MCUX_PRJSEG_middleware.audio_voice.components.vit
                    default n
            endif # MCUX_COMPONENT_middleware.audio_voice.maestro.element.audio_proc.enable

        config MCUX_COMPONENT_middleware.audio_voice.maestro.element.audio_sink.enable
            bool "Audio sink"
            default n

        config MCUX_COMPONENT_middleware.audio_voice.maestro.element.audio_src.enable
            bool "Audio source"
            default n

        config MCUX_COMPONENT_middleware.audio_voice.maestro.element.file_sink.enable
            bool "File sink"
            select MCUX_COMPONENT_middleware.audio_voice.maestro.file_utils.enable
            default n


        config MCUX_COMPONENT_middleware.audio_voice.maestro.element.file_src.enable
            bool "File source"
            select MCUX_COMPONENT_middleware.audio_voice.maestro.file_utils.enable
            default n

        config MCUX_COMPONENT_middleware.audio_voice.maestro.element.mem_sink.enable
            bool "Memory sink"
            default n

        config MCUX_COMPONENT_middleware.audio_voice.maestro.element.mem_src.enable
            bool "Memory source"
            default n

        config MCUX_COMPONENT_middleware.audio_voice.maestro.element.netbuf_src.enable
            bool "Netbuf source"
            default n

        menuconfig MCUX_COMPONENT_middleware.audio_voice.maestro.element.process_sink.enable
            bool "Process sink"
            default n
        if MCUX_COMPONENT_middleware.audio_voice.maestro.element.process_sink.enable
            config MAESTRO_ELEMENT_PROCESS_SINK_VIT_ENABLE
            bool "Enable VIT library"
            select MCUX_PRJSEG_middleware.audio_voice.components.vit
        endif # MCUX_COMPONENT_middleware.audio_voice.maestro.element.process_sink.enable

        menuconfig MCUX_COMPONENT_middleware.audio_voice.maestro.element.decoder.enable
            bool "Decoder"
            default n
            select MCUX_COMPONENT_middleware.audio_voice.maestro.cci.enable
        if MCUX_COMPONENT_middleware.audio_voice.maestro.element.decoder.enable
            config MCUX_COMPONENT_middleware.audio_voice.maestro.element.decoder.mp3.enable
                bool "MP3 decoder"
                select MCUX_COMPONENT_middleware.audio_voice.components.decoders.mp3
                default n
                depends on (MCUX_HW_CORE_CM7F || MCUX_HW_CORE_CM33 || MCUX_HW_CORE_CM33F)
            config MCUX_COMPONENT_middleware.audio_voice.maestro.element.decoder.wav.enable
                bool "WAV decoder"
                select MCUX_COMPONENT_middleware.audio_voice.components.decoders.wav
                default n
                depends on (MCUX_HW_CORE_CM7F || MCUX_HW_CORE_CM33 || MCUX_HW_CORE_CM33F)
            config MCUX_COMPONENT_middleware.audio_voice.maestro.element.decoder.flac.enable
                bool "FLAC decoder"
                select MCUX_COMPONENT_middleware.audio_voice.components.decoders.flac
                default n
                depends on (MCUX_HW_CORE_CM7F || MCUX_HW_CORE_CM33 || MCUX_HW_CORE_CM33F)
            config MCUX_COMPONENT_middleware.audio_voice.maestro.element.decoder.aac.enable
                bool "AAC decoder"
                select MCUX_COMPONENT_middleware.audio_voice.components.decoders.aac
                default n
                depends on (MCUX_HW_CORE_CM7F || MCUX_HW_CORE_CM33 || MCUX_HW_CORE_CM33F)
            config MCUX_COMPONENT_middleware.audio_voice.maestro.element.decoder.opus_ogg.enable
                bool "OPUS decoder using OGG"
                select MCUX_COMPONENT_middleware.audio_voice.components.opus
                select MCUX_COMPONENT_middleware.audio_voice.components.ogg
                select MCUX_COMPONENT_middleware.audio_voice.components.opusfile
                default n
        endif # MCUX_COMPONENT_middleware.audio_voice.maestro.element.decoder.enable

        menuconfig MCUX_COMPONENT_middleware.audio_voice.maestro.element.encoder.enable
            bool "Encoder"
            default n
            select MCUX_COMPONENT_middleware.audio_voice.maestro.cei.enable
        if MCUX_COMPONENT_middleware.audio_voice.maestro.element.encoder.enable
            config MCUX_COMPONENT_middleware.audio_voice.maestro.element.encoder.opus.enable
                bool "OPUS encoder"
                select MCUX_COMPONENT_middleware.audio_voice.components.opus
                select MCUX_COMPONENT_middleware.audio_voice.maestro.cci.enable
                select MCUX_COMPONENT_middleware.audio_voice.maestro.element.decoder.enable
                default n
        endif # MCUX_COMPONENT_middleware.audio_voice.maestro.element.encoder.enable
    endmenu

    config MCUX_COMPONENT_middleware.audio_voice.maestro.cci.enable
        bool "Enables Common codec interface"
        select MCUX_COMPONENT_middleware.audio_voice.maestro.cei.enable # dependency on common API
        default n

    config MCUX_COMPONENT_middleware.audio_voice.maestro.cei.enable
        bool "Enables Common encoder interface"
        default n

    config MCUX_COMPONENT_middleware.audio_voice.maestro.file_utils.enable
        bool "Enables File utils"
        default n
endif
```

## west.yml
```yaml
# Maestro west manifest
#
# Description:
#   Used for setting up maestro directly from Zephyr manifest
#
# Append into the Zephyr's manifest, project part:
#   - name: maestro
#     url: <this repository URL>
#     path: modules/audio/maestro
#     revision: <revision or branch>
#     import: west.yml
#
# For more information, see zephyr/README.rst
#

manifest:
  version: "1.2"

  projects:
    # Audio libraries used by Maestro
    - name: vit
      description: |
        VIT library making voice recognition.
      url: https://github.com/nxp-mcuxpresso/VIT
      path: modules/audio/vit
      revision: 24.12.00

    - name: audio_voice_components
      description: |
        NXP audio libraries (encoders, decoders, libraries)
      url: https://github.com/nxp-mcuxpresso/audio-voice-components
      path: modules/audio/audio_voice_components
      revision: 24.12.00
  self:
    path: maestro
```

## zephyr/Kconfig
```kconfig
# Copyright 2024 NXP
# SPDX-License-Identifier: BSD-3-Clause

menuconfig MAESTRO_AUDIO_FRAMEWORK
    bool "Audio Maestro framework support"
    select EVENTS # Maestro uses Events API for signaling. It is not enabled in Zephyr by default
    help
      This option enables the audio Maestro framework

if MAESTRO_AUDIO_FRAMEWORK

    menu "Elements"
        config MAESTRO_ELEMENTS_ALL_ENABLE
            bool "Enables all supported elements"
            default n
            select MAESTRO_ELEMENT_MEM_SRC_ENABLE
            select MAESTRO_ELEMENT_MEM_SINK_ENABLE
            select MAESTRO_ELEMENT_AUDIO_SRC_ENABLE
            select MAESTRO_ELEMENT_AUDIO_SINK_ENABLE
            select MAESTRO_ELEMENT_PROCESS_SINK_ENABLE
            select MAESTRO_ELEMENT_DECODER_ENABLE
            select MAESTRO_ELEMENT_ENCODER_ENABLE

        config MAESTRO_ELEMENT_MEM_SRC_ENABLE
            bool "Memory source"
            default n

        config MAESTRO_ELEMENT_MEM_SINK_ENABLE
            bool "Memory sink"
            default n

        config MAESTRO_ELEMENT_AUDIO_SRC_ENABLE
            bool "Audio source"
            default n

        config MAESTRO_ELEMENT_AUDIO_SINK_ENABLE
            bool "Audio sink"
            default n

        menuconfig MAESTRO_ELEMENT_PROCESS_SINK_ENABLE
            bool "Process sink"
            default n
        if MAESTRO_ELEMENT_PROCESS_SINK_ENABLE
            config MAESTRO_ELEMENT_PROCESS_SINK_VIT_ENABLE
                bool "Enable VIT library"
                select NXP_VIT
        endif # MAESTRO_ELEMENT_PROCESS_SINK_ENABLE

        menuconfig MAESTRO_ELEMENT_DECODER_ENABLE
            bool "Decoder"
            default n
            select MAESTRO_CCI_ENABLE
        if MAESTRO_ELEMENT_DECODER_ENABLE
            config MAESTRO_ELEMENT_DECODER_MP3_ENABLE
                bool "MP3 decoder"
                select NXP_AUDIO_VOICE_COMPONENTS_DECODER_MP3
                default n
            config MAESTRO_ELEMENT_DECODER_WAV_ENABLE
                bool "WAV decoder"
                select NXP_AUDIO_VOICE_COMPONENTS_DECODER_WAV
                default n
            config MAESTRO_ELEMENT_DECODER_FLAC_ENABLE
                bool "FLAC decoder"
                select NXP_AUDIO_VOICE_COMPONENTS_DECODER_FLAC
                default n
            config MAESTRO_ELEMENT_DECODER_AAC_ENABLE
                bool "AAC decoder"
                select NXP_AUDIO_VOICE_COMPONENTS_DECODER_AAC
                default n
            config MAESTRO_ELEMENT_DECODER_OPUS_OGG_ENABLE
                bool "OPUS decoder using OGG"
                select NXP_AUDIO_VOICE_COMPONENTS_OPUS
                select NXP_AUDIO_VOICE_COMPONENTS_OPUS_OGG
                select NXP_AUDIO_VOICE_COMPONENTS_OPUSFILE
                default n
            config MAESTRO_ELEMENT_DECODER_OPUS_ENABLE
                bool "OPUS decoder"
                select NXP_AUDIO_VOICE_COMPONENTS_OPUS
                default n
        endif # MAESTRO_ELEMENT_DECODER_ENABLE

        menuconfig MAESTRO_ELEMENT_ENCODER_ENABLE
            bool "Encoder"
            default n
            select MAESTRO_CEI_ENABLE
            select MAESTRO_CCI_ENABLE
        if MAESTRO_ELEMENT_ENCODER_ENABLE
            config MAESTRO_ELEMENT_ENCODER_OPUS_OGG_ENABLE
                bool "OPUS encoder using OGG"
                select NXP_AUDIO_VOICE_COMPONENTS_OPUS
                select NXP_AUDIO_VOICE_COMPONENTS_OPUS_OGG
                select NXP_AUDIO_VOICE_COMPONENTS_OPUSFILE
                default n
            config MAESTRO_ELEMENT_ENCODER_OPUS_ENABLE
                bool "OPUS encoder"
                select NXP_AUDIO_VOICE_COMPONENTS_OPUS
                select NXP_AUDIO_VOICE_COMPONENTS_OPUS_OGG
                select NXP_AUDIO_VOICE_COMPONENTS_OPUSFILE
        endif # MAESTRO_ELEMENT_ENCODER_ENABLE

        # config MAESTRO_ELEMENT_AUDIO_PROC_ENABLE
        #     bool "Audio process"
        #     default n

        # config MAESTRO_ELEMENT_FILE_SINK_ENABLE
        #     bool "File sink"
        #     default n

        # config MAESTRO_ELEMENT_FILE_SRC_ENABLE
        #     bool "File source"
        #     default n

        # config MAESTRO_ELEMENT_NETBUF_SRC_ENABLE
        #     bool "Netbuf source"
        #     default n

    endmenu # Elements

    config MAESTRO_CCI_ENABLE
        bool "Enables Common codec interface"
        select MAESTRO_CEI_ENABLE # dependency on common API
        default n

    config MAESTRO_CEI_ENABLE
        bool "Enables Common encoder interface"
        default n

    config MAESTRO_RTOS_ZEPHYR
        bool
        default y

endif # MAESTRO_AUDIO_FRAMEWORK
```

## zephyr/osa/Kconfig
```kconfig
# Copyright 2024 NXP
# SPDX-License-Identifier: BSD-3-Clause

config MAESTRO_OSA_USE
    bool "Adds NXP OSA layer into build."
    default y

config OSA_DEBUG_ASSERT_ENABLED
    int "Adds asserts when error occurs."
    default 0

config OSA_SHOW_API_INCOMPATIBILITIES
    int "Prints warnings/errors related to incompatible API, so user can make sure what API should be checked."
    default 0
```

## zephyr/tests/basic/testcase.yaml
```yaml
tests:
  # section.subsection
  maestro.test.basic:
    build_only: false
    # platform_allow:
    #  - native_posix
      # - native_sim
    harness: ztest
    # integration_platforms:
    #   - native_sim
    #   - rd_rw612_bga
    tags: maestro
```

## zephyr/tests/decoder/testcase.yaml
```yaml
common:
  tags:
    - audio
    - maestro
  harness: console
  harness_config:
    type: one_line
    regex:
      - "(.*)Result: OK(.*)"
  timeout: 1
  integration_platforms:
    - rd_rw612_bga
  arch_allow: arm
tests:
  maestro.test.decoder.mp3:
    extra_configs:
      - CONFIG_MAESTRO_EXAMPLE_DECODER_SELECTED_MP3=y
    filter: (CONFIG_CPU_CORTEX_M33 or CONFIG_CPU_CORTEX_M7) and CONFIG_DSP
  # maestro.test.decoder.opus:
  #   extra_configs:
  #     - CONFIG_MAESTRO_EXAMPLE_DECODER_SELECTED_OPUS=y
  maestro.test.decoder.opus_ogg:
    extra_configs:
      - CONFIG_MAESTRO_EXAMPLE_DECODER_SELECTED_OPUS_OGG=y
    # Flash and RAM usage depend on track files sizes
    min_flash: 275
    min_ram: 336
  maestro.test.decoder.wav:
    extra_configs:
      - CONFIG_MAESTRO_EXAMPLE_DECODER_SELECTED_WAV=y
    # Flash and RAM usage depend on track files sizes
    min_flash: 265
    min_ram: 336
    filter: CONFIG_CPU_CORTEX_M33 or CONFIG_CPU_CORTEX_M7
  maestro.test.decoder.flac:
    extra_configs:
      - CONFIG_MAESTRO_EXAMPLE_DECODER_SELECTED_FLAC=y
    # Flash and RAM usage depend on track files sizes
    min_flash: 217
    min_ram: 336
    filter: CONFIG_CPU_CORTEX_M33 or CONFIG_CPU_CORTEX_M7
  maestro.test.decoder.aac:
    extra_configs:
      - CONFIG_MAESTRO_EXAMPLE_DECODER_SELECTED_AAC=y
    filter: (CONFIG_CPU_CORTEX_M33 or CONFIG_CPU_CORTEX_M7) and CONFIG_DSP
```
