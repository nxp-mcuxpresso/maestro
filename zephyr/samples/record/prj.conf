## CMakeLists.txt
```
cmake_minimum_required(VERSION 3.20.0)

# add_compile_definitions(FSL_OSA_TASK_ENABLE=1)
add_compile_definitions(FSL_OSA_TASK_ENABLE=1)
set(CONFIG_USE_component_osa_zephyr true)

# Explicitelly enforcing to find specific Zephyr installation
find_package(Zephyr REQUIRED HINTS $ENV{ZEPHYR_BASE})
project(maestro_record)

# Target_sources must be specified directly after find_package. Target "app"
#file(GLOB maestro_sources src/*.c)
#target_sources(app PRIVATE ${maestro_sources})
target_sources(app PRIVATE src/main.c)
target_sources(app PRIVATE src/app_streamer_element_pcm.c)

target_include_directories(app PRIVATE src/)

# Include target module directories?
# This library, ...?
```

## Kconfig
```
menu "Maestro Record RAM Example"
	depends on MAESTRO_AUDIO_FRAMEWORK

	config MAESTRO_EXAMPLE_MAESTRO_LOGGING_ON
		bool "Turns on logging of Maestro library"
		default n

	config MAESTRO_EXAMPLE_RECORD_TIME_MS
		int "Maestro Record example - Approximate record time [ms]"
		default 2000

endmenu

source "Kconfig.zephyr"
```

## sample.yaml
```
sample:
  description: Records data from microphone and stores into RAM memory
  name: Maestro record into RAM
common:
  tags: audio maestro
  platform_allow:
   - rd_rw612_bga
tests:
  maestro.sample.record.ram:
    timeout: 3
    harness: console
    harness_config:
      type: one_line
      regex:
        - "OK"
```

## prj.conf
```kconfig
# Maestro and OSA configuration
CONFIG_MAESTRO_AUDIO_FRAMEWORK=y
CONFIG_MAESTRO_OSA_USE=y
CONFIG_MAESTRO_USE_ZEPHYR=y

# Enable maestro's specific elements
CONFIG_MAESTRO_ENABLE_ELEMENT_MEM_SINK=y
CONFIG_MAESTRO_ENABLE_ELEMENT_AUDIO_SRC=y

# Example settings
CONFIG_MAESTRO_EXAMPLE_RECORD_TIME_MS=2000

# System settings
CONFIG_HEAP_MEM_POOL_SIZE=60000
CONFIG_SYS_HEAP_ALLOC_LOOPS=12
CONFIG_SYS_HEAP_AUTO=y
CONFIG_MAIN_THREAD_PRIORITY=10
CONFIG_MAIN_STACK_SIZE=40096

# DMIC driver
CONFIG_AUDIO=y
CONFIG_AUDIO_DMIC=y
```

## src/main.c
```c
/**
 *  Copyright 2024 NXP
 *
 *  SPDX-License-Identifier: Apache-2.0
 *
 *  @file  main.c
 *  @brief Maestro example recording data from DMIC to RAM using the Maestro library.
 */

#include <stdio.h>

#include <zephyr/kernel.h>
#include <zephyr/logging/log.h>
LOG_MODULE_REGISTER(main, LOG_LEVEL_WRN);
#include <zephyr/audio/dmic.h>

#include "streamer_api.h"
#include "streamer_element_properties.h"
#include "maestro_logging.h"
#include "error.h"

#include "app_streamer_element_pcm.h"

/*******************************************************************************
 * Definitions
 ******************************************************************************/

#define STREAMER_OUT_QUEUE_NAME      "streamer outQueue"
#define STREAMER_TASK_NAME           "streamer task"
#define STREAMER_TASK_STACK_SIZE_B   (4096u)
#define STREAMER_MESSAGE_TASK_NAME   "streamer message task"
#define STREAMER_MESSAGE_TASK_STACK_SIZE (256u)
#define STREAMER_IN_DEV_NAME         "DMIC"
#define STREAMER_OUT_DEV_NAME        "RAM memory"

#define DEMO_MIC_FRAME_LENGTH_MS        (30u)
#define DEMO_MIC_AUDIO_BIT_WIDTH        (16u)
#define DEMO_MIC_AUDIO_SAMPLE_RATE_HZ   (16000u)
#define DEMO_MIC_CHANNEL_NUM            (1u)

#define DEMO_SAMPLE_SIZE_B        (DEMO_MIC_AUDIO_BIT_WIDTH/8)
#define DEMO_SAMPLES_COUNT        ((CONFIG_MAESTRO_EXAMPLE_RECORD_TIME_MS * DEMO_MIC_AUDIO_SAMPLE_RATE_HZ)/ 1000)
#define DEMO_BUFFER_SIZE_B        (DEMO_SAMPLES_COUNT * DEMO_SAMPLE_SIZE_B)
#define DEMO_BUFFER_INIT_SYMBOL   (0x00)

#if (CONFIG_MAESTRO_EXAMPLE_RECORD_TIME_MS < 100)
    #error "Recorded duration cnonstrain is too small. Increase CONFIG_MAESTRO_EXAMPLE_RECORD_TIME_MS."
#endif

/*******************************************************************************
 * Prototypes
 ******************************************************************************/

static int s_demoRun(void);

/*******************************************************************************
 * Variables
 ******************************************************************************/

static STREAMER_T *s_demo_streamerPtr;
static uint8_t s_demo_bufferDst[DEMO_BUFFER_SIZE_B] = {0};
static SET_BUFFER_DESC_T s_demo_streamer_bufferDst  = {0};
OSA_TASK_HANDLE_DEFINE(s_demo_task_streamerHandler);
static struct k_timer s_demo_timerStreamerStop_handle;

/*******************************************************************************
 * Code
 *******************************************************************************/

int main(void)
{
    printk("== Record demo ==\r\n");

    return s_demoRun();
}

static void s_demo_prepareBuffers(void)
{
    for (uint32_t i = 0; i < DEMO_BUFFER_SIZE_B; i++)
    {
        s_demo_bufferDst[i] = DEMO_BUFFER_INIT_SYMBOL;
    }
}

static bool s_demo_isBufferUnchanged(void)
{
    for (uint32_t i = 0; i < DEMO_BUFFER_SIZE_B; i++)
    {
        if (s_demo_bufferDst[i] != DEMO_BUFFER_INIT_SYMBOL)
        {
            return false;
        }
    }
    return true;
}

static void s_demo_streamerInitLogging(void)
{
    /* Initialize logging */
    init_logging();

    #if (MAESTRO_EXAMPLE_MAESTRO_LOGGING_ON)
        set_debug_module(0xffffffff);
        set_debug_level(LOGLVL_DEBUG);
        get_debug_state();
    #endif
}

static void s_demo_timerStreamerStop_expireFunc(struct k_timer * handle)
{
    LOG_DBG("Timer streamer Stop\r\n");

    /* Stop the streamer */
    streamer_set_state(s_demo_streamerPtr, 0, STATE_PAUSED, false);
}

static void s_demo_controlPrepare()
{
    /* Initialize external timer closing streamer after timeout is expired */
    k_timer_init(&s_demo_timerStreamerStop_handle, s_demo_timerStreamerStop_expireFunc, NULL);
}

static osa_status_t s_demo_streamerPrepare()
{
    int retVal = STREAM_OK;

    /* Define memory buffers for streamer */
    s_demo_streamer_bufferDst =
        (SET_BUFFER_DESC_T){.ptr = (int8_t *)s_demo_bufferDst, .size = DEMO_BUFFER_SIZE_B};

    /* Define element parameters */
    STREAMER_CREATE_PARAM streamer_params;
    ELEMENT_PROPERTY_T prop;

    /* Setup Pipeline elements */
    ElementIndex elementsList_ids[]    = {ELEMENT_MICROPHONE_INDEX, ELEMENT_MEM_SINK_INDEX};
    int elements_cnt                   = sizeof(elementsList_ids) / sizeof(ElementIndex);
    PipelineElements pipeline_elems = {elementsList_ids, elements_cnt};

    /* Setup streamer parameters */
    strcpy(streamer_params.out_mq_name, STREAMER_OUT_QUEUE_NAME);
    streamer_params.stack_size   = STREAMER_TASK_STACK_SIZE_B;
    streamer_params.task_name    = STREAMER_TASK_NAME;
    streamer_params.in_dev_name  = STREAMER_IN_DEV_NAME;
    streamer_params.out_dev_name = STREAMER_OUT_DEV_NAME;
    streamer_params.elements     = pipeline_elems;

    s_demo_streamerInitLogging();

    /* Create streamer */
    s_demo_streamerPtr = streamer_create(&streamer_params);
    if (s_demo_streamerPtr == NULL)
    {
        LOG_ERR("Streamer create failed\r\n");
        return KOSA_StatusError;
    }

    /* Setting Microphone properties */
    prop.prop = PROP_MICROPHONE_SET_SAMPLE_RATE;
    prop.val  = DEMO_MIC_AUDIO_SAMPLE_RATE_HZ;
    retVal   |= streamer_set_property(s_demo_streamerPtr, 0, prop, true);

    prop.prop = PROP_MICROPHONE_SET_BITS_PER_SAMPLE;
    prop.val  = DEMO_MIC_AUDIO_BIT_WIDTH;
    retVal   |= streamer_set_property(s_demo_streamerPtr, 0, prop, true);

    prop.prop = PROP_MICROPHONE_SET_NUM_CHANNELS;
    prop.val  = DEMO_MIC_CHANNEL_NUM;
    retVal   |= streamer_set_property(s_demo_streamerPtr, 0, prop, true);

    prop.prop = PROP_MICROPHONE_SET_FRAME_MS;
    prop.val  = DEMO_MIC_FRAME_LENGTH_MS;
    retVal   |= streamer_set_property(s_demo_streamerPtr, 0, prop, true);

    EXT_AUDIOELEMENT_DESC_T appFunctions = {
        .open_func      = streamer_pcm_rx_open,
        .close_func     = streamer_pcm_rx_close,
        .start_func     = NULL,
        .process_func   = streamer_pcm_read,
        .set_param_func = streamer_pcm_setparams,
        .get_param_func = streamer_pcm_getparams,
        .mute_func      = streamer_pcm_mute,
        .volume_func    = streamer_pcm_set_volume,
    };
    prop.prop = PROP_MICROPHONE_SET_APP_FUNCTIONS;
    prop.val  = (uintptr_t)&appFunctions;
    retVal   |= streamer_set_property(s_demo_streamerPtr, 0, prop, true);

    /* Setting Memsink properties */
    prop.prop = PROP_MEMSINK_BUFFER_DESC;
    prop.val  = (uintptr_t)&s_demo_streamer_bufferDst;
    retVal   |= streamer_set_property(s_demo_streamerPtr, 0, prop, true);

    if (retVal != STREAM_OK)
    {
        LOG_ERR("Streamer set property failed\r\n");
        streamer_destroy(s_demo_streamerPtr);
        s_demo_streamerPtr = NULL;

        return KOSA_StatusError;
    }

    return KOSA_StatusSuccess;
}

static osa_status_t s_demo_streamerCleanup()
{
    k_timer_stop(&s_demo_timerStreamerStop_handle);

    if (OSA_MsgQDestroy(s_demo_streamerPtr->message_channel_out.mq) != KOSA_StatusSuccess)
    {
        LOG_ERR("Could not destroy out message queue\r\n");
        return KOSA_StatusError;
    }
    s_demo_streamerPtr->message_channel_out.is_mq_created = false;

    if (streamer_destroy(s_demo_streamerPtr) != ERRCODE_NO_ERROR)
    {
        LOG_ERR("Could not destroy streamer\r\n");
        return KOSA_StatusError;
    }

    return KOSA_StatusSuccess;
}

static osa_status_t s_demo_streamerRunStart()
{
    /* Start timer stopping the streamer after timeout */
    k_timer_start(&s_demo_timerStreamerStop_handle, K_MSEC(CONFIG_MAESTRO_EXAMPLE_RECORD_TIME_MS), K_NO_WAIT);

    LOG_INF("Streamer start encoding\r\n");
    if(streamer_set_state(s_demo_streamerPtr, 0, STATE_PLAYING, true) != ERRCODE_NO_ERROR)
    {
        s_demo_streamerCleanup();
        return KOSA_StatusError;
    }

    return KOSA_StatusSuccess;
}

static osa_status_t s_demo_streamerRunProcess()
{
    /* Process responses from streamer task */
    osa_status_t retVal;
    STREAMER_MSG_T msg;
    do
    {
        /* Try to obtain message from streamer task */
        retVal = OSA_MsgQGet(s_demo_streamerPtr->message_channel_out.mq, (void *)&msg, 50);
        switch (retVal)
        {
            case KOSA_StatusTimeout:
                /* No message from streamer */
                PipelineState pipState;
                streamer_get_state(s_demo_streamerPtr, 0, &pipState, false);

                /* Detects if Pipeline was stopped by timer s_demo_timerStreamerStop_handle after timeout */
                if(pipState == STATE_PAUSED)
                {
                    LOG_DBG("Pipeline was stopped\r\n");
                    s_demo_streamerCleanup();
                    return KOSA_StatusSuccess;
                } else
                {
                    continue;
                }

            case KOSA_StatusSuccess:
                LOG_DBG("Message queue get message id: %u\r\n", msg.id);

                /* Decode the message */
                switch (msg.id)
                {
                    case STREAM_MSG_ERROR:
                        LOG_ERR("Streamer MSG - error id: %u\r\n", msg.id);
                        s_demo_streamerCleanup();
                        return KOSA_StatusError;
                    case STREAM_MSG_EOS:
                        LOG_DBG("Streamer MSG - end of stream\r\n");
                        s_demo_streamerCleanup();
                        return KOSA_StatusSuccess;
                    case STREAM_MSG_CLOSE_TASK:
                        LOG_DBG("Streamer MSG - close task\r\n");
                        s_demo_streamerCleanup();
                        return KOSA_StatusSuccess;
                    default:
                        LOG_ERR("Streamer MSG - got message with undefined reaction. Msg ID: %u\r\n", msg.id);
                        s_demo_streamerCleanup();
                        return KOSA_StatusError;
                        break;
                }

            case KOSA_StatusError:
                LOG_ERR("Message queue get error\r\n");
                return KOSA_StatusError;

            default:
                LOG_ERR("Unhandled message get response");
                break;
        }
    } while (true); /* Repeat processing messages from streamer */

    /* Should not get there */
    return KOSA_StatusError;
}

static osa_status_t s_demo_streamerRun()
{
    osa_status_t retVal = s_demo_streamerRunStart();

    if(retVal != KOSA_StatusSuccess)
    {
        return retVal;
    }

    return s_demo_streamerRunProcess();
}

static int s_demoRun(void)
{
    osa_status_t retVal = KOSA_StatusSuccess;

    /* =================================
     *  Prepare phase
     * ================================= */
    printk("Demo Preparation\r\n");
    printk("Recorded length set: %u [ms]\r\n", CONFIG_MAESTRO_EXAMPLE_RECORD_TIME_MS);
    s_demo_prepareBuffers();
    s_demo_controlPrepare();
    retVal = s_demo_streamerPrepare();

    /* =================================
     *  Run phase
     * ================================= */
    if (KOSA_StatusSuccess == retVal)
    {
        printk("Demo Start\r\n");
        retVal = s_demo_streamerRun();
    }

    /* =================================
     *  Control phase
     * ================================= */
    bool isStreamerFail = (retVal != KOSA_StatusSuccess);
    bool isBufferEmpty  = (s_demo_isBufferUnchanged());

    if (isStreamerFail || isBufferEmpty)
    {
        printk("\r\nDemo result: FAIL\r\n");
        return -1;
    } else
    {
#if 0
        printk("\n\rData: ");
        for(int i = 0; i < RECORD_SAMPLES_COUNT; i = i + 2)
        {
            printk("%x%x ", s_mem2mem_bufferDst[i], s_mem2mem_bufferDst[i+1]);
        }
#endif
    }

    printk("\r\nDemo result: OK\r\n");
    return 0;
}
```

## src/app_streamer_element_pcm.c
```c
/*
 * Copyright 2024 NXP
 * All rights reserved.
 *
 * SPDX-License-Identifier: BSD-3-Clause
 *
 *  @file  app_Streamer_element_pcm.c
 *  @brief Implementation of application dependent audio source - pcm element (microphone)
 */

#include <stdio.h>

#include <zephyr/kernel.h>
#include <zephyr/logging/log.h>
LOG_MODULE_REGISTER(demo_appStreamerElm_pcm, LOG_LEVEL_WRN);
#include <zephyr/audio/dmic.h>

#include "streamer_api.h"
#include "streamer_element_properties.h"
#include "app_streamer_element_pcm.h"

#define BLOCK_SIZE(_sample_rate, _number_of_channels) \
	(BYTES_PER_SAMPLE * (_sample_rate / 10) * _number_of_channels)

#define DEMO_RECORD_FRAME_LENGTH_MS (30u)
#define DEMO_RECORD_DMA_BUFFER_COUNT (6u)

struct maestro_pcm_config
{
    uint32_t sample_rate;
    uint32_t bit_width;
    uint8_t num_channels;
    bool transfer;
    bool dummy_tx;
    int volume;
};
static struct maestro_pcm_config s_record_config = {0};

static struct pcm_stream_cfg s_pcm_stream_cfg = {0};
static struct dmic_cfg s_dmic_cfg = {0};
static struct k_mem_slab s_memSlab;
static uint8_t * s_memSlab_buffer;
struct device const * s_dev_dmic = DEVICE_DT_GET(DT_NODELABEL(dmic0));

volatile static int8_t PDM_started = 0;     /** Indicates that the PDM transfer has already started. */

void streamer_pcm_init(void)
{
    LOG_DBG("PCM Init\r\n.");

    return;
}

int streamer_pcm_rx_open(uint32_t num_buffers)
{
    PDM_started = 0;

    /* Check if dmic peripheral is ready */
	if (!device_is_ready(s_dev_dmic))
    {
		LOG_ERR("Dmic device %s is not ready", s_dev_dmic->name);
		return -1;
	}

    return 0;
}

void streamer_pcm_rx_close(void)
{
    LOG_DBG("Streamer close");

    if(dmic_trigger(s_dev_dmic, DMIC_TRIGGER_STOP) != 0)
    {
        __ASSERT(false, "DMIC cannot be stopped");
        LOG_ERR("PCM Close Error");
    }
}

void streamer_pcm_start(void)
{
    LOG_DBG("Start function\r\n");
}

int streamer_pcm_read(uint8_t *data, uint32_t size)
{
    int retVal          = -1;
    uint32_t readSize_B = 0;
    void *readBuffer    = NULL;

    if (PDM_started == 0)
    {
        retVal = dmic_trigger(s_dev_dmic, DMIC_TRIGGER_START);
        if (retVal < 0)
        {
            LOG_ERR("START trigger failed: %d", retVal);
        }
        PDM_started = 1;
    }

    retVal = dmic_read(s_dev_dmic, 0, &readBuffer, &readSize_B, 5000);
	if (retVal < 0)
    {
		LOG_ERR("Read failed: %d", retVal);
        return -1;
	}

    if(size < readSize_B)
    {
        LOG_ERR("Recorded data loss and skew. Size: %u, ReadSIze: %u", size, readSize_B);
    } else if(size > readSize_B)
    {
        LOG_ERR("Returned wrong data located in padding and skew. Size: %u, ReadSIze: %u", size, readSize_B);
    } else
    {
        memcpy(data, readBuffer, size);
    }

    printk(".");

    k_mem_slab_free(&s_memSlab, readBuffer);

    return 0;
}

int streamer_pcm_setparams(
    uint32_t sample_rate, uint32_t bit_width, uint8_t num_channels, bool transfer, bool dummy_tx, int volume)
{
    int retVal;

    if(num_channels != 1)
    {
        LOG_ERR("CUrrently Supported only 1 channel.");
        return -1;
    }

    s_record_config.bit_width    = bit_width;
    s_record_config.sample_rate  = sample_rate;
    s_record_config.num_channels = num_channels;
    s_record_config.dummy_tx     = dummy_tx;

    uint32_t bytesPerSecond  = ((bit_width/8) * sample_rate * num_channels);
    uint32_t bytesPerBuffer  = (bytesPerSecond * DEMO_RECORD_FRAME_LENGTH_MS / 1000);
    uint32_t bytesPerBuffers = (bytesPerBuffer * DEMO_RECORD_DMA_BUFFER_COUNT);

    /* PCM Streams configuration */
    s_pcm_stream_cfg.pcm_width  = s_record_config.bit_width;
    s_pcm_stream_cfg.pcm_rate   = s_record_config.sample_rate;
    s_pcm_stream_cfg.block_size = bytesPerBuffer;
    s_pcm_stream_cfg.mem_slab   = & s_memSlab;

    s_memSlab_buffer = k_aligned_alloc(32, bytesPerBuffers);
    if(s_memSlab_buffer == NULL)
    {
        LOG_ERR("Allocation of memory slab buffer failed");
        return -1;
    }

    retVal = k_mem_slab_init(& s_memSlab, s_memSlab_buffer, bytesPerBuffer, DEMO_RECORD_DMA_BUFFER_COUNT);
    if(retVal != 0)
    {
        LOG_ERR("Initialization of memory slab failed.");
        return -1;
    }

    s_dmic_cfg.streams = &s_pcm_stream_cfg;

    /* Configuration of DMIC I/O */
    s_dmic_cfg.io.max_pdm_clk_dc = 60;
    s_dmic_cfg.io.max_pdm_clk_freq = 3500000;
    s_dmic_cfg.io.min_pdm_clk_dc = 40;
    s_dmic_cfg.io.min_pdm_clk_freq = 1000000;
    s_dmic_cfg.io.pdm_clk_skew = 0;
    s_dmic_cfg.io.pdm_data_pol = 0;

    /* Mapping Channels to Streams */
    s_dmic_cfg.channel.req_num_chan = s_record_config.num_channels;
    s_dmic_cfg.channel.req_num_streams = 1;

    s_dmic_cfg.channel.req_chan_map_hi =
        dmic_build_channel_map(0, 0, PDM_CHAN_LEFT);

    retVal = dmic_configure(s_dev_dmic, &s_dmic_cfg);
	if (retVal < 0)
    {
		LOG_ERR("Failed to configure the driver: %d", retVal);
		return -1;
	}

    return 0;
}

void streamer_pcm_getparams(uint32_t *sample_rate, uint32_t *bit_width, uint8_t *num_channels)
{
    *sample_rate  = s_record_config.sample_rate;
    *bit_width    = s_record_config.bit_width;
    *num_channels = s_record_config.num_channels;
}

int streamer_pcm_mute(bool mute)
{
    LOG_DBG("Streamer Mute");
    return 0;
}

int streamer_pcm_set_volume(int volume)
{
    __ASSERT(false, "Streamer Mute called!");

    return 0;
}
```
