## CMakeLists.txt
```
# Copyright 2024 NXP
# SPDX-License-Identifier: BSD-3-Clause

cmake_minimum_required(VERSION 3.20.0)

add_compile_definitions(FSL_OSA_TASK_ENABLE=1)
set(CONFIG_USE_component_osa_zephyr true)

# Explicitelly enforcing to find specific Zephyr installation
find_package(Zephyr REQUIRED HINTS $ENV{ZEPHYR_BASE})
project(maestro_record_vit)

# Target_sources must be specified directly after find_package. Target "app"
target_sources(app PRIVATE src/main.c)
target_sources(app PRIVATE src/app_streamer_element_pcm.c)
target_sources(app PRIVATE src/app_streamer_element_vit.c)

target_include_directories(app PRIVATE src/)
```

## Kconfig
```
# Copyright 2024 NXP
# SPDX-License-Identifier: BSD-3-Clause

menu "Maestro VIT Example"
	depends on MAESTRO_AUDIO_FRAMEWORK

	config MAESTRO_EXAMPLE_MAESTRO_LOGGING_ON
		bool "Turns on Maestro library logging"
		default n

	config MAESTRO_EXAMPLE_STREAMER_TASK_STACK_SIZE_B
		int "Stack size of streamer task running the pipeline."
		default 4096

	choice MAESTRO_EXAMPLE_VIT_LANGUAGE
		prompt "VIT languages support"
		default MAESTRO_EXAMPLE_VIT_LANGUAGE_EN_ENABLE

		config MAESTRO_EXAMPLE_VIT_LANGUAGE_EN_ENABLE
			bool "Enables English language pack"

		config MAESTRO_EXAMPLE_VIT_LANGUAGE_CN_ENABLE
			bool "Enables Chinese language pack"

		config MAESTRO_EXAMPLE_VIT_LANGUAGE_DE_ENABLE
			bool "Enables Deutch language pack"

		config MAESTRO_EXAMPLE_VIT_LANGUAGE_ES_ENABLE
			bool "Enables Espanol language pack"

		config MAESTRO_EXAMPLE_VIT_LANGUAGE_FR_ENABLE
			bool "Enables French language pack"

		config MAESTRO_EXAMPLE_VIT_LANGUAGE_IT_ENABLE
			bool "Enables Italian language pack"

		config MAESTRO_EXAMPLE_VIT_LANGUAGE_JA_ENABLE
			bool "Enables Japaneese language pack"

		config MAESTRO_EXAMPLE_VIT_LANGUAGE_KO_ENABLE
			bool "Enables Korean language pack"

		config MAESTRO_EXAMPLE_VIT_LANGUAGE_TR_ENABLE
			bool "Enables Turkish language pack"

	endchoice
endmenu

source "Kconfig.zephyr"
```

## sample.yaml
```
sample:
  description: Records data from microphone and detects voice commands in selected language using VIT library
  name: Maestro voice recognition sample (VIT)
common:
  tags: audio maestro vit
  depends_on: dmic
  arch_allow: arm
tests:
  maestro.sample.record.vit:
    integration_platforms:
      - rd_rw612_bga
    platform_allow:
      - rd_rw612_bga
    harness: console
    timeout: 1
    harness_config:
      type: one_line
      regex:
        - "Number of channels supported by VIT lib"
    min_ram: 470
    min_flash: 400
```

## prj.conf
```kconfig
# Maestro and OSA configuration
CONFIG_MAESTRO_AUDIO_FRAMEWORK=y

# Enable maestro's specific elements
CONFIG_MAESTRO_ELEMENT_AUDIO_SRC_ENABLE=y
CONFIG_MAESTRO_ELEMENT_PROCESS_SINK_ENABLE=y
CONFIG_MAESTRO_ELEMENT_PROCESS_SINK_VIT_ENABLE=y

# =============================================
# = USER INPUT NEEDED
# =============================================
# Select one precompiled VIT language model pack.
CONFIG_MAESTRO_EXAMPLE_VIT_LANGUAGE_EN_ENABLE=y
# CONFIG_MAESTRO_EXAMPLE_VIT_LANGUAGE_CN_ENABLE=y
# CONFIG_MAESTRO_EXAMPLE_VIT_LANGUAGE_DE_ENABLE=y
# CONFIG_MAESTRO_EXAMPLE_VIT_LANGUAGE_ES_ENABLE=y
# CONFIG_MAESTRO_EXAMPLE_VIT_LANGUAGE_FR_ENABLE=y
# CONFIG_MAESTRO_EXAMPLE_VIT_LANGUAGE_IT_ENABLE=y
# CONFIG_MAESTRO_EXAMPLE_VIT_LANGUAGE_JA_ENABLE=y
# CONFIG_MAESTRO_EXAMPLE_VIT_LANGUAGE_KO_ENABLE=y
# CONFIG_MAESTRO_EXAMPLE_VIT_LANGUAGE_TR_ENABLE=y
# =============================================

# System settings - Memory space
# May be tuned according to platform capabilities
CONFIG_HEAP_MEM_POOL_SIZE=350000
CONFIG_MAESTRO_EXAMPLE_STREAMER_TASK_STACK_SIZE_B=4096
CONFIG_MAIN_STACK_SIZE=20000

# System settings
CONFIG_SYS_HEAP_ALLOC_LOOPS=12
CONFIG_SYS_HEAP_AUTO=y
CONFIG_MAIN_THREAD_PRIORITY=10
CONFIG_CMSIS_DSP=y
CONFIG_CMSIS_DSP_MATRIX=y
CONFIG_FP_HARDABI=y
CONFIG_FPU=y

# DMIC driver
CONFIG_AUDIO=y
CONFIG_AUDIO_DMIC=y
```

## src/main.c
```c
/**
 * Copyright 2024 NXP
 * All rights reserved.
 *
 * SPDX-License-Identifier: BSD-3-Clause
 *
 *  @file  main.c
 *  @brief Maestro example recognizing voice commands from DMIC microphone using VIT library
 */

#include <stdio.h>

#include <zephyr/kernel.h>
#include <zephyr/logging/log.h>
LOG_MODULE_REGISTER(main, LOG_LEVEL_ERR);
#include <zephyr/audio/dmic.h>
#include <zephyr/drivers/gpio.h>

#include "streamer_api.h"
#include "streamer_element_properties.h"
#include "maestro_logging.h"
#include "error.h"

#include "app_streamer_element_pcm.h"
#include "app_streamer_element_vit.h"

/*******************************************************************************
 * Definitions
 ******************************************************************************/

#define STREAMER_OUT_QUEUE_NAME      "Streamer outQueue"
#define STREAMER_TASK_NAME           "Streamer task"
#define STREAMER_TASK_STACK_SIZE_B   (CONFIG_MAESTRO_EXAMPLE_STREAMER_TASK_STACK_SIZE_B)
#define STREAMER_IN_DEV_NAME         "DMIC"
#define STREAMER_OUT_DEV_NAME        "VIT library"

#define DEMO_MIC_CHANNEL_NUM            (1u)
#define DEMO_MIC_FRAME_LENGTH_MS        (30u)
#define DEMO_MIC_AUDIO_BIT_WIDTH        (16u)
#define DEMO_MIC_AUDIO_SAMPLE_RATE_HZ   (16000u)

/*******************************************************************************
 * Prototypes
 ******************************************************************************/

static int s_demoRun(void);

/*******************************************************************************
 * Variables
 ******************************************************************************/

static STREAMER_T *s_demo_streamerPtr;

/*******************************************************************************
 * Code
 *******************************************************************************/

int main(void)
{
    printk("== Voice recognition demo ==");

    return s_demoRun();
}

static void s_demo_streamerInitLogging(void)
{
    /* Initialize logging */
    init_logging();

    #if (CONFIG_MAESTRO_EXAMPLE_MAESTRO_LOGGING_ON)
        set_debug_module(0xffffffff);
        set_debug_level(LOGLVL_DEBUG);
        get_debug_state();
    #endif
}

static osa_status_t s_demo_streamerPrepare(void)
{
    int retVal = STREAM_OK;

    /* Define element parameters */
    STREAMER_CREATE_PARAM streamer_params;
    ELEMENT_PROPERTY_T prop;

    /* Setup Pipeline elements */
    ElementIndex elementsList_ids[]    = {ELEMENT_MICROPHONE_INDEX, ELEMENT_VIT_INDEX};
    int elements_cnt                   = sizeof(elementsList_ids) / sizeof(ElementIndex);
    PipelineElements pipeline_elems = {elementsList_ids, elements_cnt};

    /* Setup streamer parameters */
    strcpy(streamer_params.out_mq_name, STREAMER_OUT_QUEUE_NAME);
    streamer_params.stack_size   = STREAMER_TASK_STACK_SIZE_B;
    streamer_params.task_name    = STREAMER_TASK_NAME;
    streamer_params.in_dev_name  = STREAMER_IN_DEV_NAME;
    streamer_params.out_dev_name = STREAMER_OUT_DEV_NAME;
    streamer_params.elements     = pipeline_elems;

    s_demo_streamerInitLogging();

    /* Create streamer */
    s_demo_streamerPtr = streamer_create(&streamer_params);
    if (s_demo_streamerPtr == NULL)
    {
        LOG_ERR("Streamer create failed\r\n");
        return KOSA_StatusError;
    }

    /* Setting Microphone properties */
    prop.prop = PROP_MICROPHONE_SET_SAMPLE_RATE;
    prop.val  = DEMO_MIC_AUDIO_SAMPLE_RATE_HZ;
    retVal   |= streamer_set_property(s_demo_streamerPtr, 0, prop, true);

    prop.prop = PROP_MICROPHONE_SET_BITS_PER_SAMPLE;
    prop.val  = DEMO_MIC_AUDIO_BIT_WIDTH;
    retVal   |= streamer_set_property(s_demo_streamerPtr, 0, prop, true);

    prop.prop = PROP_MICROPHONE_SET_NUM_CHANNELS;
    prop.val  = DEMO_MIC_CHANNEL_NUM;
    retVal   |= streamer_set_property(s_demo_streamerPtr, 0, prop, true);

    prop.prop = PROP_MICROPHONE_SET_FRAME_MS;
    prop.val  = DEMO_MIC_FRAME_LENGTH_MS;
    retVal   |= streamer_set_property(s_demo_streamerPtr, 0, prop, true);

    EXT_AUDIOELEMENT_DESC_T appFunctions = {
        .open_func      = streamer_pcm_rx_open,
        .close_func     = streamer_pcm_rx_close,
        .start_func     = NULL,
        .process_func   = streamer_pcm_read,
        .set_param_func = streamer_pcm_setparams,
        .get_param_func = streamer_pcm_getparams,
        .mute_func      = streamer_pcm_mute,
        .volume_func    = streamer_pcm_set_volume,
    };
    prop.prop = PROP_MICROPHONE_SET_APP_FUNCTIONS;
    prop.val  = (uintptr_t)&appFunctions;
    retVal   |= streamer_set_property(s_demo_streamerPtr, 0, prop, true);

    /* Setting VIT properties */
    EXT_PROCESS_DESC_T vit_proc = {VIT_Initialize_func, VIT_Execute_func, VIT_Deinit_func, NULL};

    prop.prop = PROP_VITSINK_FUNCPTR;
    prop.val = (uintptr_t)&vit_proc;
    streamer_set_property(s_demo_streamerPtr, 0, prop, true);

    if (retVal != STREAM_OK)
    {
        LOG_ERR("Streamer set property failed\r\n");
        streamer_destroy(s_demo_streamerPtr);
        s_demo_streamerPtr = NULL;

        return KOSA_StatusError;
    }

    return KOSA_StatusSuccess;
}

static osa_status_t s_demo_streamerCleanup()
{
    if (OSA_MsgQDestroy(s_demo_streamerPtr->message_channel_out.mq) != KOSA_StatusSuccess)
    {
        LOG_ERR("Could not destroy out message queue\r\n");
        return KOSA_StatusError;
    }
    s_demo_streamerPtr->message_channel_out.is_mq_created = false;

    if (streamer_destroy(s_demo_streamerPtr) != ERRCODE_NO_ERROR)
    {
        LOG_ERR("Could not destroy streamer\r\n");
        return KOSA_StatusError;
    }

    return KOSA_StatusSuccess;
}

static osa_status_t s_demo_streamerRunStart()
{
    LOG_DBG("Streamer start encoding\r\n");
    if(streamer_set_state(s_demo_streamerPtr, 0, STATE_PLAYING, true) != ERRCODE_NO_ERROR)
    {
        s_demo_streamerCleanup();
        return KOSA_StatusError;
    }

    return KOSA_StatusSuccess;
}

static osa_status_t s_demo_streamerRunProcess()
{
    /* Process responses from streamer task */
    osa_status_t retVal;
    STREAMER_MSG_T msg;
    do
    {
        retVal = OSA_MsgQGet(s_demo_streamerPtr->message_channel_out.mq, (void *)&msg, 0xFFFFFFFF);
        switch (retVal)
        {
            case KOSA_StatusTimeout:
                LOG_ERR("Message queue get timeouted\r\n");
                break;
            case KOSA_StatusError:
                LOG_ERR("Message queue get error\r\n");
                break;
            case KOSA_StatusSuccess:
                /* Message obtained */
                LOG_DBG("Message queue get message id: %u\r\n", msg.id);
                break;
            default:
                LOG_ERR("Unhandled message get response");
                break;
        }
        if (retVal != KOSA_StatusSuccess)
        {
            s_demo_streamerCleanup();
            return KOSA_StatusError;
        }

        /* Decode the message */
        switch (msg.id)
        {
            case STREAM_MSG_ERROR:
                LOG_ERR("Streamer MSG - error id: %u\r\n", msg.id);
                s_demo_streamerCleanup();
                return KOSA_StatusError;
            case STREAM_MSG_EOS:
                LOG_DBG("Streamer MSG - end of stream\r\n");
                s_demo_streamerCleanup();
                return KOSA_StatusSuccess;
            case STREAM_MSG_CLOSE_TASK:
                LOG_DBG("Streamer MSG - close task\r\n");
                s_demo_streamerCleanup();
                return KOSA_StatusSuccess;
            default:
                LOG_WRN("Streamer MSG - got message with undefined reaction\r\n");
                break;
        }
    } while (true);

    /* Should not get there */
    return KOSA_StatusError;
}

static osa_status_t s_demo_streamerRun()
{
    osa_status_t retVal = s_demo_streamerRunStart();

    if(retVal != KOSA_StatusSuccess)
    {
        return retVal;
    }

    return s_demo_streamerRunProcess();
}

static int s_demoRun(void)
{
    osa_status_t retVal = KOSA_StatusSuccess;

    /* =================================
     *  Prepare phase
     * ================================= */
    LOG_INF("Demo Preparation");
    retVal = s_demo_streamerPrepare();

    /* =================================
     *  Run phase
     * ================================= */
    if (KOSA_StatusSuccess == retVal)
    {
        LOG_DBG("Demo Start\r\n");
        retVal = s_demo_streamerRun();
    }

    /* =================================
     *  Control phase
     * ================================= */
    if (retVal != KOSA_StatusSuccess)
    {
        printk("Demo result: FAIL\r\n");
        return -1;
    }

    printk("Demo result: OK\r\n");
    return 0;
}
```

## src/app_streamer_element_pcm.c
```c
/*
 * Copyright 2024 NXP
 * All rights reserved.
 *
 * SPDX-License-Identifier: BSD-3-Clause
 *
 *  @file  app_Streamer_element_pcm.c
 *  @brief Implementation of application dependent audio source - pcm element (microphone)
 */

#include <stdio.h>

#include <zephyr/kernel.h>
#include <zephyr/logging/log.h>
LOG_MODULE_REGISTER(demo_appStreamerElm_pcm, LOG_LEVEL_WRN);
#include <zephyr/audio/dmic.h>

#include "streamer_api.h"
#include "streamer_element_properties.h"
#include "app_streamer_element_pcm.h"

#define BLOCK_SIZE(_sample_rate, _number_of_channels) \
	(BYTES_PER_SAMPLE * (_sample_rate / 10) * _number_of_channels)

#define DEMO_RECORD_FRAME_LENGTH_MS (30u)
#define DEMO_RECORD_DMA_BUFFER_COUNT (6u)

struct maestro_pcm_config
{
    uint32_t sample_rate;
    uint32_t bit_width;
    uint8_t num_channels;
    bool transfer;
    bool dummy_tx;
    int volume;
};
static struct maestro_pcm_config s_record_config = {0};

static struct pcm_stream_cfg s_pcm_stream_cfg = {0};
static struct dmic_cfg s_dmic_cfg = {0};
static struct k_mem_slab s_memSlab;
static uint8_t * s_memSlab_buffer;
struct device const * s_dev_dmic = DEVICE_DT_GET(DT_NODELABEL(dmic0));

volatile static int8_t PDM_started = 0;     /* Indicates that the PDM transfer has already started. */

void streamer_pcm_init(void)
{
    LOG_DBG("PCM Init\r\n.");

    return;
}

int streamer_pcm_rx_open(uint32_t num_buffers)
{
    PDM_started = 0;

    /* Check if dmic peripheral is ready */
	if (!device_is_ready(s_dev_dmic))
    {
		LOG_ERR("Dmic device %s is not ready", s_dev_dmic->name);
		return -1;
	}

    return 0;
}

void streamer_pcm_rx_close(void)
{
    LOG_DBG("Streamer close");

    if(dmic_trigger(s_dev_dmic, DMIC_TRIGGER_STOP) != 0)
    {
        __ASSERT(false, "DMIC cannot be stopped");
        LOG_ERR("PCM Close Error");
    }
}

int streamer_pcm_read(uint8_t *data, uint32_t size)
{
    int retVal          = -1;
    uint32_t readSize_B = 0;
    void *readBuffer    = NULL;

    if (PDM_started == 0)
    {
        retVal = dmic_trigger(s_dev_dmic, DMIC_TRIGGER_START);
        if (retVal < 0)
        {
            LOG_ERR("START trigger failed: %d", retVal);
        }
        PDM_started = 1;

        return 0;
    }

    retVal = dmic_read(s_dev_dmic, 0, &readBuffer, &readSize_B, 1000);
    LOG_DBG("Read called. Size to read: %u. \r\n", readSize_B);
	if (retVal < 0)
    {
		LOG_ERR("Read failed: %d", retVal);
        return -1;
	}

    if(size < readSize_B)
    {
        LOG_ERR("Recorded data loss and skew. Size: %u, ReadSIze: %u", size, readSize_B);
    } else if(size > readSize_B)
    {
        LOG_ERR("Returned wrong data located in padding and skew. Size: %u, ReadSIze: %u", size, readSize_B);
    } else
    {
        memcpy(data, readBuffer, size);
    }

    LOG_DBG("# SLAB FREE. Before: %u\r\n", s_memSlab.info.num_used);
    k_mem_slab_free(&s_memSlab, readBuffer);
    LOG_DBG("# SLAB FREE. After: %u\r\n", s_memSlab.info.num_used);

    return 0;
}

int streamer_pcm_setparams(
    uint32_t sample_rate, uint32_t bit_width, uint8_t num_channels, bool transfer, bool dummy_tx, int volume)
{
    int retVal;

    if(num_channels != 1)
    {
        LOG_ERR("CUrrently Supported only 1 channel.");
        return -1;
    }

    s_record_config.bit_width    = bit_width;
    s_record_config.sample_rate  = sample_rate;
    s_record_config.num_channels = num_channels;
    s_record_config.dummy_tx     = dummy_tx;

    uint32_t bytesPerSecond  = ((bit_width/8) * sample_rate * num_channels);
    uint32_t bytesPerBuffer  = (bytesPerSecond * DEMO_RECORD_FRAME_LENGTH_MS / 1000);
    uint32_t bytesPerBuffers = (bytesPerBuffer * DEMO_RECORD_DMA_BUFFER_COUNT);

    /* PCM Streams configuration */
    s_pcm_stream_cfg.pcm_width  = s_record_config.bit_width;
    s_pcm_stream_cfg.pcm_rate   = s_record_config.sample_rate;
    s_pcm_stream_cfg.block_size = bytesPerBuffer;
    s_pcm_stream_cfg.mem_slab   = & s_memSlab;

    s_memSlab_buffer = k_aligned_alloc(32, bytesPerBuffers);
    if(s_memSlab_buffer == NULL)
    {
        LOG_ERR("Allocation of memory slab buffer failed");
        return -1;
    }

    retVal = k_mem_slab_init(& s_memSlab, s_memSlab_buffer, bytesPerBuffer, DEMO_RECORD_DMA_BUFFER_COUNT);
    if(retVal != 0)
    {
        LOG_ERR("Initialization of memory slab failed.");
        return -1;
    }

    s_dmic_cfg.streams = &s_pcm_stream_cfg;

    /* Configuration of DMIC I/O */
    s_dmic_cfg.io.max_pdm_clk_dc = 60;
    s_dmic_cfg.io.max_pdm_clk_freq = 3500000;
    s_dmic_cfg.io.min_pdm_clk_dc = 40;
    s_dmic_cfg.io.min_pdm_clk_freq = 1000000;
    s_dmic_cfg.io.pdm_clk_skew = 0;
    s_dmic_cfg.io.pdm_data_pol = 0;

    /* Mapping Channels to Streams */
    s_dmic_cfg.channel.req_num_chan = s_record_config.num_channels;
    s_dmic_cfg.channel.req_num_streams = 1;

    s_dmic_cfg.channel.req_chan_map_hi =
        dmic_build_channel_map(0, 0, PDM_CHAN_LEFT);

    retVal = dmic_configure(s_dev_dmic, &s_dmic_cfg);
	if (retVal < 0)
    {
		LOG_ERR("Failed to configure the driver: %d", retVal);
		return -1;
	}

    return 0;
}

void streamer_pcm_getparams(uint32_t *sample_rate, uint32_t *bit_width, uint8_t *num_channels)
{
    *sample_rate  = s_record_config.sample_rate;
    *bit_width    = s_record_config.bit_width;
    *num_channels = s_record_config.num_channels;
}

int streamer_pcm_mute(bool mute)
{
    LOG_DBG("Streamer Mute");
    return 0;
}

int streamer_pcm_set_volume(int volume)
{
    __ASSERT(false, "Streamer Mute called!");

    return 0;
}
```

## src/app_streamer_element_pcm.h
```c
/*
 * Copyright 2024 NXP
 * All rights reserved.
 *
 * SPDX-License-Identifier: BSD-3-Clause
 *
 *  @file  app_Streamer_element_pcm.h
 *  @brief Implementation of application dependent audio source - pcm element (microphone)
 */

#ifndef _STREAMER_ELEMENT_PCM_H_
#define _STREAMER_ELEMENT_PCM_H_

#if defined(__cplusplus)
extern "C" {
#endif

/*******************************************************************************
 * API
 ******************************************************************************/
/*!
 * @brief Initialize the PCM interface
 *
 * This function initializes the PCM interface for audio data output to a
 * speaker or input from a microphone on a specific target hardware platform.
 * This function should be executed directly by the application or other
 * middleware library, and should be called before any other PCM interface functions.
 * This function is responsible for initializing and configuring audio output
 * peripherals, DMA and codecs so that they are ready to utilitize the PCM
 * interface library.
 */
void streamer_pcm_init(void);

/*!
 * @brief Open the receive PCM interface for reading and configuring
 *
 * This function returns a handle to the PCM interface that can be used for
 * configuration and reading the data.
 *
 * This function is called from the streamer when it is placed into a playing
 * state, before audio input starts.
 *
 * @param num_buffers Number of buffers to be used
 * @return 0 for success
 */
int streamer_pcm_rx_open(uint32_t num_buffers);

/*!
 * @brief Close the receive PCM interface
 *
 * This function closes the handle to the PCM interface
 *
 * This function is called from the streamer when it is placed into a stopped
 * state.
 */
void streamer_pcm_rx_close(void);

/*!
 * @brief Read audio data from the input PCM interface
 *
 * This function reads raw PCM data from the PCM input interface
 *
 * This function is called from the streamer to input raw audio data.
 *
 * @param data Pointer to next data buffer with PCM data
 * @param size Size in bytes of the data buffer
 * @return 0 on success, non-zero on failure
 */
int streamer_pcm_read(uint8_t *data, uint32_t size);

/*!
 * @brief Set PCM interface parameters
 *
 * This function is called from the streamer after the start of audio data
 * decode, once the parameters of the data format are known. The PCM interface
 * should be configured to match these parameters. The pcm handle should
 * reflect the values configured.
 *
 * If the PCM interface cannot support these parameters, the pcm handle should
 * be set to the nearest values the interface can support and success should be
 * returned.  These will be queried by the streamer with streamer_pcm_getparams,
 * and the streamer will resample or reconfigure the audio format to fit the
 * desired output.
 *
 * @param sample_rate Sample rate in Hz of the PCM data
 * @param bit_width Size of each PCM data sample, in bits
 * @param num_channels Number of channels of audio data for each PCM frame
 * @param transfer Flag for setting params of input/output pcm interface
 * @param dummy_tx Dummy tx setting for clock enablement
 * @param volume Output volume
 * @return 0 on success, non-zero on failure
 */
int streamer_pcm_setparams(
    uint32_t sample_rate, uint32_t bit_width, uint8_t num_channels, bool transfer, bool dummy_tx, int volume);

/*!
 * @brief Get PCM interface parameters
 *
 * This function is called by the streamer after streamer_pcm_setparams, and
 * should reflect what parameters can be supported by the PCM interface. If
 * these do not match what was requested in streamer_pcm_setparams, the streamer
 * will attempt to configure SRC or other behavior to adjust the data format.
 * If the streamer cannot support this, it will return a failure status to the
 * application via the message task.
 *
 * @param sample_rate Pointer to pcm handle sample rate
 * @param bit_width Pointer to pcm handle bit width
 * @param num_channels Pointer to pcm handle number of channels
 */
void streamer_pcm_getparams(uint32_t *sample_rate, uint32_t *bit_width, uint8_t *num_channels);

/*!
 * @brief Set PCM interface mute status
 *
 * This function is called by the streamer while entering the stopped state to
 * mute the PCM output codec. This function is optional to implement as not all
 * codecs will support this functionality.
 *
 * @param mute Boolean indicated true/false requested codec mute state
 * @return 0 on success, non-zero on failurefstreamer_pcm_set_volume
 */
int streamer_pcm_mute(bool mute);

/*!
 * @brief Set PCM interface output volume
 *
 * This function is called by the application interface to adjust the output
 * volume for the PCM interface.
 *
 * @param volume Volume on a scale from 0-100
 * @return 0 on success, non-zero on failure
 */
int streamer_pcm_set_volume(int volume);

#if defined(__cplusplus)
}
#endif

#endif // _STREAMER_ELEMENT_PCM_H_
```

## src/app_streamer_element_vit.c
```c
/*
 * Copyright 2020-2024 NXP
 * All rights reserved.
 *
 * SPDX-License-Identifier: BSD-3-Clause
 *
 *  @file  app_Streamer_element_pcm.c
 *  @brief Implementation of application dependent vit element
 */

#include <stdio.h>
#include <stddef.h>
#include <string.h>
#include <math.h>

#include <zephyr/kernel.h>
#include <zephyr/logging/log.h>
LOG_MODULE_REGISTER(demo_appStreamerElm_vit, LOG_LEVEL_WRN);

#include "streamer_api.h"
#include "streamer.h"
#include "streamer_element_properties.h"
#include "app_streamer_element_vit.h"
#include "VIT.h"

#include "fsl_os_abstraction.h"
#include "fsl_debug_console.h"

/* List of available VIT language models */
#ifdef CONFIG_MAESTRO_EXAMPLE_VIT_LANGUAGE_EN_ENABLE
#include "VIT_Model_en.h"
#endif
#ifdef CONFIG_MAESTRO_EXAMPLE_VIT_LANGUAGE_CN_ENABLE
#include "VIT_Model_cn.h"
#endif
#ifdef CONFIG_MAESTRO_EXAMPLE_VIT_LANGUAGE_DE_ENABLE
#include "VIT_Model_de.h"
#endif
#ifdef CONFIG_MAESTRO_EXAMPLE_VIT_LANGUAGE_ES_ENABLE
#include "VIT_Model_es.h"
#endif
#ifdef CONFIG_MAESTRO_EXAMPLE_VIT_LANGUAGE_FR_ENABLE
#include "VIT_Model_fr.h"
#endif
#ifdef CONFIG_MAESTRO_EXAMPLE_VIT_LANGUAGE_IT_ENABLE
#include "VIT_Model_it.h"
#endif
#ifdef CONFIG_MAESTRO_EXAMPLE_VIT_LANGUAGE_JA_ENABLE
#include "VIT_Model_ja.h"
#endif
#ifdef CONFIG_MAESTRO_EXAMPLE_VIT_LANGUAGE_KO_ENABLE
#include "VIT_Model_ko.h"
#endif
#ifdef CONFIG_MAESTRO_EXAMPLE_VIT_LANGUAGE_TR_ENABLE
#include "VIT_Model_tr.h"
#endif

#define MODEL_LOCATION (VIT_MODEL_IN_SLOW_MEM)

#if defined(CONFIG_SOC_SERIES_RW6XX)
#define DEVICE_ID VIT_RW610
#elif (defined(CONFIG_SOC_MIMXRT1064) || defined(CONFIG_SOC_MIMXRT1061) || defined(CONFIG_SOC_MIMXRT1062))
#define DEVICE_ID VIT_IMXRT1060
#error AA
#elif defined(CONFIG_SOC_MIMXRT1166)
#define DEVICE_ID VIT_IMXRT1160
#error AA
#elif defined(CONFIG_SOC_MIMXRT1176)
#define DEVICE_ID VIT_IMXRT1170
#error AA
#elif defined(CONFIG_SOC_LPC55S69)
#define DEVICE_ID VIT_LPC55S69
#error AA
#else
#error "Platform is not supported by VIT."
#endif

#define BYTE_DEPTH         (2u)
#define NUMBER_OF_CHANNELS (1u)
#define VIT_CMD_TIME_SPAN  (3.0)
#define VIT_OPERATING_MODE (VIT_WAKEWORD_ENABLE | VIT_VOICECMD_ENABLE)

#define SAMPLES_PER_FRAME VIT_SAMPLES_PER_30MS_FRAME
#define MEMORY_ALIGNMENT  8                   // in bytes

static VIT_Handle_t VITHandle = PL_NULL;      // VIT handle pointer
static VIT_InstanceParams_st VITInstParams;   // VIT instance parameters structure
static VIT_ControlParams_st VITControlParams; // VIT control parameters structure
static PL_MemoryTable_st VITMemoryTable;      // VIT memory table descriptor
static PL_BOOL InitPhase_Error = PL_FALSE;
// static VIT_DataIn_st VIT_InputBuffers = {PL_NULL, PL_NULL,
//                                         PL_NULL}; // Resetting Input Buffer addresses provided to VIT_process() API
static PL_INT8 *pMemory[PL_NR_MEMORY_REGIONS];

VIT_ReturnStatus_en VIT_ModelInfo(void)
{
    VIT_ReturnStatus_en VIT_Status;
    VIT_ModelInfo_st Model_Info;
    VIT_Status = VIT_GetModelInfo(&Model_Info);
    if (VIT_Status != VIT_SUCCESS)
    {
        PRINTF("VIT_GetModelInfo error: %d\r\n", VIT_Status);
        return VIT_INVALID_MODEL;
    }

    PRINTF("\n  VIT Model info\r\n");
    PRINTF("  VIT Model Release: 0x%04x\r\n", Model_Info.VIT_Model_Release);
    if (Model_Info.pLanguage != PL_NULL)
    {
        PRINTF("  Language supported: %s \r\n", Model_Info.pLanguage);
    }
    PRINTF("  Number of WakeWords supported : %d \r\n", Model_Info.NbOfWakeWords);
    PRINTF("  Number of Commands supported : %d \r\n", Model_Info.NbOfVoiceCmds);

    if (!Model_Info.WW_VoiceCmds_Strings) // Check here if Model is containing WW and CMDs strings
    {
        PRINTF("  VIT_Model integrating WakeWord and Voice Commands strings: NO\r\n");
    }
    else
    {
        const char *ptr;

        PRINTF("  VIT_Model integrating WakeWord and Voice Commands strings: YES\r\n");
        PRINTF("  WakeWords supported : \r\n");
        ptr = Model_Info.pWakeWord_List;
        if (ptr != PL_NULL)
        {
            for (PL_UINT16 i = 0; i < Model_Info.NbOfWakeWords; i++)
            {
                PRINTF("   '%s' \r\n", ptr);
                ptr += strlen(ptr) + 1;
            }
        }
        PRINTF("  Voice commands supported: \r\n");
        ptr = Model_Info.pVoiceCmds_List;
        if (ptr != PL_NULL)
        {
            for (PL_UINT16 i = 0; i < Model_Info.NbOfVoiceCmds; i++)
            {
                PRINTF("   '%s' \r\n", ptr);
                ptr += strlen(ptr) + 1;
            }
        }
    }
    /*
     *   VIT Get Library information
     */
    VIT_LibInfo_st Lib_Info;
    VIT_Status = VIT_GetLibInfo(&Lib_Info);
    if (VIT_Status != VIT_SUCCESS)
    {
        PRINTF("VIT_GetLibInfo error: %d\r\n", VIT_Status);
        return VIT_INVALID_STATE;
    }
    PRINTF("\n  VIT Lib Info\r\n");
    PRINTF("  VIT LIB Release: 0x%04x\r\n", Lib_Info.VIT_LIB_Release);
    PRINTF("  VIT Features supported by the lib: 0x%04x\r\n", Lib_Info.VIT_Features_Supported);
    PRINTF("  Number of channels supported by VIT lib: %d\r\n", Lib_Info.NumberOfChannels_Supported);

    /*
     *   Configure VIT Instance Parameters
     */
    /* Check that NUMBER_OF_CHANNELS is supported by VIT */
    /* Retrieve from VIT_GetLibInfo API the number of channel supported by the VIT lib */
    PL_UINT16 max_nb_of_Channels = Lib_Info.NumberOfChannels_Supported;
    if (NUMBER_OF_CHANNELS > max_nb_of_Channels)
    {
        PRINTF("VIT lib is supporting only: %d channels\r\n", max_nb_of_Channels);
        return VIT_INVALID_PARAMETER_OUTOFRANGE;
    }
    return VIT_SUCCESS;
}

int VIT_Initialize(void *arg)
{
    volatile VIT_ReturnStatus_en VIT_Status;
    uint16_t i, minIdx; /* loop index */
    int32_t temp32;     /* temporary address */
    int16_t j;          /* loop index */
    uint16_t order[PL_NR_MEMORY_REGIONS];

    uint8_t const * selectedModel   = NULL;

#if defined(CONFIG_MAESTRO_EXAMPLE_VIT_LANGUAGE_CN_ENABLE)
    selectedModel = VIT_Model_cn;
#elif defined(CONFIG_MAESTRO_EXAMPLE_VIT_LANGUAGE_EN_ENABLE)
    selectedModel = VIT_Model_en;
#elif defined(CONFIG_MAESTRO_EXAMPLE_VIT_LANGUAGE_ES_ENABLE)
    selectedModel = VIT_Model_es;
#elif defined(CONFIG_MAESTRO_EXAMPLE_VIT_LANGUAGE_FR_ENABLE)
    selectedModel = VIT_Model_fr;
#elif defined(CONFIG_MAESTRO_EXAMPLE_VIT_LANGUAGE_IT_ENABLE)
    selectedModel = VIT_Model_it;
#elif defined(CONFIG_MAESTRO_EXAMPLE_VIT_LANGUAGE_JA_ENABLE)
    selectedModel = VIT_Model_ja;
#elif defined(CONFIG_MAESTRO_EXAMPLE_VIT_LANGUAGE_KO_ENABLE)
    selectedModel = VIT_Model_ko;
#elif defined(CONFIG_MAESTRO_EXAMPLE_VIT_LANGUAGE_TR_ENABLE)
    selectedModel = VIT_Model_tr;
#elif defined(CONFIG_MAESTRO_EXAMPLE_VIT_LANGUAGE_DE_ENABLE)
    selectedModel = VIT_Model_de;
#else
    #error "Language model must be selected! "
#endif

    VIT_Status = VIT_SetModel(selectedModel, MODEL_LOCATION);

    if (VIT_Status != VIT_SUCCESS)
    {
        return VIT_Status;
    }

    VIT_Status = VIT_ModelInfo();
    if (VIT_Status != VIT_SUCCESS)
    {
        return VIT_Status;
    }
    /*
     *   Configure VIT Instance Parameters
     */
    VITInstParams.SampleRate_Hz   = VIT_SAMPLE_RATE;
    VITInstParams.SamplesPerFrame = SAMPLES_PER_FRAME;
    VITInstParams.NumberOfChannel = NUMBER_OF_CHANNELS;
    VITInstParams.DeviceId        = DEVICE_ID;
    VITInstParams.APIVersion      = VIT_API_VERSION;

    /*
     *   VIT get memory table: Get size info per memory type
     */
    VIT_Status = VIT_GetMemoryTable(PL_NULL, // VITHandle param should be NULL
                                    &VITMemoryTable, &VITInstParams);
    if (VIT_Status != VIT_SUCCESS)
    {
        PRINTF("VIT_GetMemoryTable error: %d\r\n", VIT_Status);
        return VIT_Status;
    }

    /* Initialize order variable */
    for (i = 0; i < PL_NR_MEMORY_REGIONS; i++)
    {
        order[i] = i;
    }

    /* Sort region indexes by region size */
    for (i = 0; i < (PL_NR_MEMORY_REGIONS - 1); i++)
    {
        minIdx = i;
        for (j = i + 1; j < PL_NR_MEMORY_REGIONS; j++)
            if (VITMemoryTable.Region[order[j]].Size < VITMemoryTable.Region[order[minIdx]].Size)
                minIdx = j;

        /* Swap indexes */
        temp32        = order[minIdx];
        order[minIdx] = order[i];
        order[i]      = temp32;
    }

    /*
     *   Reserve memory space: Malloc for each memory type
     */
    for (j = (PL_NR_MEMORY_REGIONS - 1); j >= 0; j--)
    {
        /* Log the memory size */
        if (VITMemoryTable.Region[order[j]].Size != 0)
        {
            /* reserve memory space
             * NB: VITMemoryTable.Region[PL_MEMREGION_PERSISTENT_FAST_DATA] should be allocated
             *      in the fastest memory of the platform (when possible) - this is not the case in this example. */
            pMemory[j] = OSA_MemoryAllocate(VITMemoryTable.Region[order[j]].Size + MEMORY_ALIGNMENT);
            if (!pMemory[j])
            {
                return VIT_INVALID_NULLADDRESS;
            }
            VITMemoryTable.Region[order[j]].pBaseAddress = (void *)pMemory[j];
        }
    }

    /*
     *    Create VIT Instance
     */
    VITHandle  = PL_NULL; // force to null address for correct memory initialization
    VIT_Status = VIT_GetInstanceHandle(&VITHandle, &VITMemoryTable, &VITInstParams);
    if (VIT_Status != VIT_SUCCESS)
    {
        InitPhase_Error = PL_TRUE;
        PRINTF("VIT_GetInstanceHandle error: %d\r\n", VIT_Status);
    }

    /*
     *    Test the reset (OPTIONAL)
     */
    if (!InitPhase_Error)
    {
        VIT_Status = VIT_ResetInstance(VITHandle);
        if (VIT_Status != VIT_SUCCESS)
        {
            InitPhase_Error = PL_TRUE;
            PRINTF("VIT_ResetInstance error: %d\r\n", VIT_Status);
        }
    }

    /*
     *   Set and Apply VIT control parameters
     */
    VITControlParams.OperatingMode     = VIT_OPERATING_MODE;
    VITControlParams.Feature_LowRes    = PL_FALSE;
    VITControlParams.Command_Time_Span = VIT_CMD_TIME_SPAN;

    if (!InitPhase_Error)
    {
        VIT_Status = VIT_SetControlParameters(VITHandle, &VITControlParams);
        if (VIT_Status != VIT_SUCCESS)
        {
            InitPhase_Error = PL_TRUE;
            PRINTF("VIT_SetControlParameters error: %d\r\n", VIT_Status);
        }
    }
    /*
        //Public call to VIT_GetStatusParameters
        VIT_StatusParams_st* pVIT_StatusParam_Buffer = (VIT_StatusParams_st*)&VIT_StatusParams_Buffer;

        VIT_GetStatusParameters(VITHandle, pVIT_StatusParam_Buffer, sizeof(VIT_StatusParams_Buffer));
        PRINTF("\nVIT Status Params\n");
        PRINTF(" VIT LIB Release   = 0x%04x\n", pVIT_StatusParam_Buffer->VIT_LIB_Release);
        PRINTF(" VIT Model Release = 0x%04x\n", pVIT_StatusParam_Buffer->VIT_MODEL_Release);
        PRINTF(" VIT Features supported by the lib = 0x%04x\n", pVIT_StatusParam_Buffer->VIT_Features_Supported);
        PRINTF(" VIT Features Selected             = 0x%04x\n", pVIT_StatusParam_Buffer->VIT_Features_Selected);
        PRINTF(" Number of channels supported by VIT lib = %d\n", pVIT_StatusParam_Buffer->NumberOfChannels_Supported);
        PRINTF(" Device Selected: device id = %d\n", pVIT_StatusParam_Buffer->Device_Selected);
        if (pVIT_StatusParam_Buffer->WakeWord_In_Text2Model)
        {
            PRINTF(" VIT WakeWord in Text2Model\n ");
        }
        else
        {
            PRINTF(" VIT WakeWord in Audio2Model\n ");
        }
    */
    return VIT_Status;
}

int VIT_Execute(void *arg, void *inputBuffer, int size)
{
    StreamBuffer *buf    = (StreamBuffer *)inputBuffer;
    int8_t *pkt_hdr_size = (int8_t *)arg;
    void *buffer         = NULL;
    VIT_ReturnStatus_en VIT_Status;
    VIT_VoiceCommand_st VoiceCommand;                               // Voice Command info
    VIT_WakeWord_st WakeWord;                                       // Wakeword info
    VIT_DetectionStatus_en VIT_DetectionResults = VIT_NO_DETECTION; // VIT detection result

    if ((buf == NULL) || (pkt_hdr_size == NULL))
    {
        return VIT_INVALID_NULLADDRESS;
    }

    /* Initialization of the variables */
    buffer = (void *)(buf->buffer + *pkt_hdr_size);

    if (size != SAMPLES_PER_FRAME * NUMBER_OF_CHANNELS * BYTE_DEPTH)
    {
        PRINTF("Input buffer format issue\r\n");
        return VIT_INVALID_FRAME_SIZE;
    }

    VIT_Status = VIT_Process(VITHandle,
                             buffer, // temporal audio input data
                             &VIT_DetectionResults);

    if (VIT_Status != VIT_SUCCESS)
    {
        PRINTF("VIT_Process error: %d\r\n", VIT_Status);
        return VIT_Status; // will stop processing VIT and go directly to MEM free
    }

    if (VIT_DetectionResults == VIT_WW_DETECTED)
    {
        /* Retrieve id of the WakeWord detected */
        /* String of the Command can also be retrieved (when WW and CMDs strings are integrated in Model) */
        VIT_Status = VIT_GetWakeWordFound(VITHandle, &WakeWord);
        if (VIT_Status != VIT_SUCCESS)
        {
            PRINTF("VIT_GetWakeWordFound error : %d\r\n", VIT_Status);
            return VIT_Status; // will stop processing VIT and go directly to MEM free
        }
        else
        {
            PRINTF(" - WakeWord detected %d", WakeWord.Id);

            /* Retrieve WakeWord Name : OPTIONAL */
            /* Check first if WakeWord string is present */
            if (WakeWord.pName != PL_NULL)
            {
                PRINTF(" %s\r\n", WakeWord.pName);
            }
        }
    }
    else if (VIT_DetectionResults == VIT_VC_DETECTED)
    {
        /* Retrieve id of the Voice Command detected */
        /* String of the Command can also be retrieved (when WW and CMDs strings are integrated in Model) */
        VIT_Status = VIT_GetVoiceCommandFound(VITHandle, &VoiceCommand);
        if (VIT_Status != VIT_SUCCESS)
        {
            PRINTF("VIT_GetVoiceCommandFound error: %d\r\n", VIT_Status);
            return VIT_Status; // will stop processing VIT and go directly to MEM free
        }
        else
        {
            PRINTF(" - Voice Command detected %d", VoiceCommand.Id);

            /* Retrieve CMD Name: OPTIONAL */
            /* Check first if CMD string is present */
            if (VoiceCommand.pName != PL_NULL)
            {
                PRINTF(" %s\r\n", VoiceCommand.pName);
            }
            else
            {
                PRINTF("\r\n");
            }
        }
    }
    return VIT_Status;
}

int VIT_Deinit(void)
{
    VIT_ReturnStatus_en VIT_Status;   /* Function call status */
                                      /* retrieve size of the different MEM tables allocated */
    VIT_Status =
        VIT_GetMemoryTable(VITHandle, /* Should provide VIT_Handle to retrieve the size of the different MemTabs */
                           &VITMemoryTable, &VITInstParams);
    if (VIT_Status != VIT_SUCCESS)
    {
        PRINTF("VIT_GetMemoryTable error: %d\r\n", VIT_Status);
    }

    /* Free the MEM tables */
    for (int i = 0; i < PL_NR_MEMORY_REGIONS; i++)
    {
        if (pMemory[i] != NULL)
        {
            OSA_MemoryFree((PL_INT8 *)pMemory[i]);
            pMemory[i] = NULL;
        }
    }

    return VIT_Status;
}

VIT_Initialize_T VIT_Initialize_func = VIT_Initialize;
VIT_Execute_T VIT_Execute_func       = VIT_Execute;
VIT_Deinit_T VIT_Deinit_func         = VIT_Deinit;
```
